//drum machine
const unsigned char bass[] PROGMEM = 
{
0x82,0x7C,0x88,0xC4,0xC6,0xC1,0xC0,0xBC,0xBB,0xB8,
0xB6,0xB4,0xB2,0xB0,0xAD,0xAC,0xA8,0xAA,0xB6,0xB3,
0xB0,0xAC,0xA9,0xA6,0xA2,0x9E,0x9B,0x97,0x93,0x8F,
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0x6F,0x73,0x76,0x79,0x7C,0x7D,0x7F,0x81};
const unsigned char hat[] PROGMEM = {
  0x81, 0x7E, 0x7F, 0x69, 0x93, 0x80, 0x8D, 0x81, 0x81, 0x91,
  0xAA, 0xB2, 0x7C, 0x99, 0x75, 0x74, 0x8F, 0x8E, 0x66, 0x8B,
  0x70, 0x79, 0x8D, 0x7F, 0x55, 0x51, 0x6F, 0x47, 0x86, 0x6C,
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  0x7F, 0x7F, 0x7F };
const unsigned char kick[] PROGMEM = {
  0x80, 0x7F, 0x7E, 0x80, 0x7B, 0x7F, 0x77, 0x80, 0x6F, 0x78,
  0x70, 0x86, 0x6B, 0x8E, 0x83, 0x81, 0x2F, 0x3B, 0xC5, 0x5E,
  0x5E, 0x80, 0x67, 0x6C, 0x8B, 0x70, 0x96, 0x79, 0x9E, 0x8D,
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  0x7F, 0x7F, 0x7F, };
const unsigned char snare[] PROGMEM = {
  0x80, 0x7E, 0x81, 0x7E, 0x82, 0x7D, 0x83, 0x7C, 0x84, 0x78,
  0xA7, 0xB6, 0xA7, 0x9C, 0xA3, 0x9A, 0x86, 0x8A, 0x5C, 0x6D,
  0x48, 0x63, 0x27, 0x38, 0x56, 0x0E, 0x31, 0x4F, 0x30, 0x32,
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  0x6A, 0x6B, 0x6F, 0x76, 0x7A, 0x7D, 0x78, 0x80, 0x74, 0x7F,
};

#include <LiquidCrystal.h>
LiquidCrystal lcd(12, 10, 4 ,5, 7, 6);
volatile int bpm = 128;
volatile unsigned char track[32] = {
1,1,4,0,2,0,4,0,1,0,4,0,2,0,4,0,
1,0,4,0,2,0,4,0,1,0,4,0,2,0,2,2
};

void button1()
{
  if(bpm > 100)
    bpm = 32;
    else
    bpm = 128;
}
volatile int trackPos = 0;
void button2()
{
  switch(track[trackPos])
  {
    case 0:
    track[trackPos] = 1;
    break;
    case 1:
    track[trackPos] = 2;
    break;
    case 2:
    track[trackPos] = 4;
    break;
    case 4:
    track[trackPos] = 8;
    break;
    case 8:
    track[trackPos] = 0;
    break;
  }
}
void setup()
{
  attachInterrupt(digitalPinToInterrupt(3), button1, RISING);
  attachInterrupt(digitalPinToInterrupt(2), button2, RISING);
  
  lcd.begin(16, 2);
  lcd.cursor();
  Serial.begin(9600);
  pinMode(11, OUTPUT);
  pinMode(3, INPUT);
  pinMode(2, INPUT);
  TCCR2A = _BV(COM2A1) | _BV(COM2B1) | _BV(WGM21) | _BV(WGM20);
  TCCR2B = _BV(CS00);
}


float so = 0;
/*
unsigned char track[32] =
{ 1, 0, 4,0, 2, 0, 4, 0, 1, 0, 4, 0, 2, 0, 4, 0
, 1, 4, 4, 4, 2, 0, 4, 0, 1, 0, 4, 0, 2, 0, 2, 2 };
*/
/*
unsigned char track[32] =
{ 1, 0, 0, 0, 5, 0, 0, 0, 1, 1, 1, 1, 5, 1, 1, 1
, 1, 0, 0, 0, 5, 0, 0, 0, 1, 0, 0, 0, 5, 0, 0, 0};
*/
/*
unsigned char track[32] =
{ 1, 0, 9, 0, 2, 0, 9, 0, 1, 0, 9, 0, 2, 0, 9, 0
, 1, 0, 9, 0, 2, 0, 9, 0, 1, 0, 9, 0, 2, 0, 9, 0};
*/




unsigned char soundBuf[1024];

char st[] = " KS H   B*";

int odb = 0;
int db = 0;

int ob = 0;
int osb = 0;
void loop()
{  so = (analogRead(0)-100)/16;
 
  int bt = millis();

  if (track[trackPos] == 0)
  {
    if(trackPos%16==0)
    {
    for (int i = 0; i < 150; i++)
    {
      OCR2A = (sin(i)+1)*127;
      delayMicroseconds(40);
    }
    }
    else if(trackPos%4==0)
    {
      for (int i = 0; i < 150; i++)
    {
      OCR2A = (sin(i/2)+1)*127;
      delayMicroseconds(40);
    }
    }
  }
  if (track[trackPos] == 1)
  {
    for (int i = 0; i < (sizeof(kick) / sizeof(kick[0])); i++)
    {
      OCR2A = pgm_read_word(&kick[i]);
      delayMicroseconds(125 + so);
    }
  }
  else if (track[trackPos] == 2)
  {
    for (int i = 0; i < (sizeof(snare) / sizeof(snare[0])); i++)
    {
      OCR2A = pgm_read_word(&snare[i]);
      delayMicroseconds(125 + so);
    }
  }
  else if(track[trackPos] == 3)
  {
    for (int i = 0; i < (sizeof(kick) / sizeof(kick[0])); i++)
    {
      float rd = (pgm_read_word(&kick[i]));
      float rd2 = (pgm_read_word(&snare[i]));
      float g = (rd/2) + (rd/2);
      OCR2A = g;
      delayMicroseconds(100 + so);
    }
  }
  else if (track[trackPos] == 4)
  {
    for (int i = 0; i < (sizeof(hat) / sizeof(hat[0])); i++)
    {
      OCR2A = pgm_read_word(&hat[i]);
      delayMicroseconds(125 + so);
    }
  }
 else if (track[trackPos] == 5)
  {
    for (int i = 0; i < (sizeof(hat) / sizeof(hat[0])); i++)
    {
      float rd = (pgm_read_word(&kick[i]));
      float rd2 = (pgm_read_word(&hat[i]));
      float g = (rd/2) + (rd/2);
      OCR2A = g;
      delayMicroseconds(100 + so);
    }
  }
  else if (track[trackPos] == 8)
  {
    for (int i = 0; i < (sizeof(bass) / sizeof(bass[0])); i++)
    {
       OCR2A = pgm_read_word(&bass[i]);
      delayMicroseconds(100 + so);
    }
  }
   else if (track[trackPos] == 9)
  {
    for (int i = 0; i < (sizeof(hat) / sizeof(hat[0])); i++)
    {
      float rd = (pgm_read_word(&bass[i]));
      float rd2 = (pgm_read_word(&hat[i]));
      float g = rd2;
      OCR2A = g;
      delayMicroseconds(100 + so);
    }
  }
  int dt = millis() - bt;
  int wt = (((60000 / bpm) / 4) - dt);
  delay(abs(wt));

lcd.setCursor(trackPos%16,trackPos>15);
lcd.write(st[track[trackPos]]);
  
 trackPos++;
  if (trackPos >= 32)
    trackPos = 0;
}
